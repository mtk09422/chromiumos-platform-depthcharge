## board/llama/defconfig
```kconfig
# Arch
CONFIG_ARCH_ARM=y

# Board
CONFIG_BOARD="llama"

# Image
CONFIG_BASE_ADDRESS=0x83000000
CONFIG_FMAP_OFFSET=0x00100000
CONFIG_HEAP_SIZE=0x00600000
CONFIG_KERNEL_START=0x81000000

# Vboot
CONFIG_VIRTUAL_DEV_SWITCH=y

CONFIG_CROSSYSTEM_FDT=y
CONFIG_NV_STORAGE_CROS_EC=y

# Kernel format
CONFIG_KERNEL_FIT=y
CONFIG_KERNEL_FIT_FDT_ADDR=0x9ff00000

# Drivers
CONFIG_DRIVER_BUS_I2C_MT8135=y
CONFIG_DRIVER_BUS_SPI_MTK=y
CONFIG_DRIVER_EC_CROS=y
CONFIG_DRIVER_EC_CROS_SPI=y
CONFIG_DRIVER_FLASH_MTK_EMMC=y
CONFIG_DRIVER_GPIO_MT8135=y
CONFIG_DRIVER_POWER_MT6397=y
CONFIG_DRIVER_STORAGE_MMC=y
CONFIG_DRIVER_STORAGE_MT8135=y
CONFIG_DRIVER_TPM_SLB9635_I2C=y
```
